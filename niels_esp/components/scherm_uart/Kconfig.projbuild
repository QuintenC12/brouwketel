## niels_esp/components/scherm_uart/Kconfig.projbuild
```kconfig
menu "Niels ESP"

    config SCHERM_UART_TX_GPIO
        int "UART1 TX naar scherm IO44"
        range 0 48
        default 17
        help
            Kies een vrije GPIO van jouw ESP32-S3. Standaard GPIO17.

    config SCHERM_UART_RX_GPIO
        int "UART1 RX vanaf scherm IO43"
        range 0 48
        default 18
        help
            Kies een vrije GPIO van jouw ESP32-S3. Standaard GPIO18.
            Gebruik dezelfde GPIO niet ook als SPI-klok voor de MAX31865.

endmenu
```

## niels_esp/main/Kconfig.projbuild
```kconfig
menu "Niels ESP: wifi en ketel"

    config NIELS_WIFI_NAAM
        string "Wifi-naam (SSID)"
        default "mijn-wifi"

    config NIELS_WIFI_WACHTWOORD
        string "Wifi-wachtwoord"
        default "mijn-wachtwoord"

    config NIELS_PIN_SSR
        int "SSR (verwarming)"
        range 0 48
        default 5

    config NIELS_PIN_POMP
        int "Pomp"
        range 0 48
        default 6

    config NIELS_PIN_ZOEMER
        int "Zoemer"
        range 0 48
        default 7

endmenu
```
