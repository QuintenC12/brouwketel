## niels_esp/main/Kconfig.projbuild
```kconfig
menu "Niels ESP: ketel en wifi-setup"

    config NIELS_SETUP_WACHTWOORD
        string "Wachtwoord van de setup-hotspot (8 tot 63 tekens)"
        default "admin123"
        help
            Met dit wachtwoord verbind je met Brouwketel-Setup-XXXXXX om
            wifi en de MQTT-broker in te vullen. Kies per ketel een eigen.

    config NIELS_PIN_SSR
        int "SSR (verwarming)"
        range 0 48
        default 5

    config NIELS_PIN_POMP
        int "Pomp"
        range 0 48
        default 6

    config NIELS_PIN_ZOEMER
        int "Zoemer"
        range 0 48
        default 7

endmenu
```
